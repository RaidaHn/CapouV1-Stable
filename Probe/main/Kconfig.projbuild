## Probe/main/Kconfig.projbuild
```kconfig
menu "LoRa Base Station Configuration"

    choice FLASH_LED
        prompt "Flash LED type"
        default FLASH_LED_GPIO if IDF_TARGET_ESP32
        default FLASH_LED_RMT
        help
            Defines the default peripheral for blink example

        config FLASH_LED_GPIO
            bool "GPIO"
        config FLASH_LED_RMT
            bool "RMT - Addressable LED"
    endchoice

    config FLASH_LED_RMT_CHANNEL
        depends on FLASH_LED_RMT
        int "RMT Channel"
        range 0 7
        default 0
        help
            Set the RMT peripheral channel.
            ESP32 RMT channel from 0 to 7
            ESP32-S2 RMT channel from 0 to 3
            ESP32-S3 RMT channel from 0 to 3
            ESP32-C3 RMT channel from 0 to 1

    config FLASH_LED_GPIO
        int "Flash led GPIO number"
        range 0 48
        default 8 if IDF_TARGET_ESP32C3 || IDF_TARGET_ESP32H2
        default 18 if IDF_TARGET_ESP32S2
        default 48 if IDF_TARGET_ESP32S3
        default 4
        help
            GPIO number (IOxx) to blink on and off or the RMT signal for the addressable LED.
            Some GPIOs are used for other purposes (flash connections, etc.) and cannot be used to blink.
endmenu
```
